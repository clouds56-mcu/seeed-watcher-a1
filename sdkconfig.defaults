## sdkconfig.defaults
```kconfig
CONFIG_IDF_TARGET="esp32s3"
CONFIG_ESPTOOLPY_FLASHSIZE_32MB=y
CONFIG_PARTITION_TABLE_CUSTOM=y
CONFIG_PARTITION_TABLE_CUSTOM_FILENAME="partitions.csv"
CONFIG_SPIRAM=y
CONFIG_SPIRAM_MODE_OCT=y
CONFIG_SPIRAM_SPEED_80M=y
CONFIG_ESP_DEFAULT_CPU_FREQ_MHZ_240=y
CONFIG_LV_COLOR_16_SWAP=y
CONFIG_LV_MEM_SIZE_KILOBYTES=128
CONFIG_LV_FONT_MONTSERRAT_16=y
CONFIG_LV_FONT_MONTSERRAT_22=y
CONFIG_LV_FONT_MONTSERRAT_32=y
CONFIG_LVGL_INPUT_DEVICE_USE_KNOB=n
CONFIG_LVGL_INPUT_DEVICE_USE_TP=n
CONFIG_BSP_LCD_DEFAULT_BRIGHTNESS=65
CONFIG_LOG_DEFAULT_LEVEL_WARN=y
CONFIG_ESP_MAIN_TASK_STACK_SIZE=8192
CONFIG_LV_USE_RLOTTIE=n

CONFIG_COMPILER_OPTIMIZATION_PERF=y
CONFIG_LVGL_PORT_TASK_MAX_SLEEP_MS=10
CONFIG_LVGL_PORT_TASK_AFFINITY_CPU1=y
```
